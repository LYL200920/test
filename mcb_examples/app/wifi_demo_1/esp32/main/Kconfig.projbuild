## mcb_examples/app/wifi_demo_1/esp32/main/Kconfig.projbuild
```kconfig
menu "Example Configuration"

config ESP_WIFI_SSID
    string "WiFi SSID"
    default "esp32"
    help
	SSID (network name) for the example to connect to.

config ESP_WIFI_PASSWORD
    string "WiFi Password"
    default "esp32pwd"
    help
	WiFi password (WPA or WPA2) for the example to use.
		
config ESP_MAX_STA_CONN
    int "Maximal STA connections"
    default 4
    help
	Max number of the STA connects to AP.


endmenu
```
